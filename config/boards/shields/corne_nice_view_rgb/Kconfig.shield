## config/boards/shields/corne_nice_view_rgb/Kconfig.shield
```kconfig
config SHIELD_CORNE_NICE_VIEW_RGB
    def_bool $(shields_list_contains,corne_nice_view_rgb)
```

## config/boards/shields/corne_oled_status/Kconfig.shield
```kconfig
config SHIELD_CORNE_OLED_STATUS
    def_bool $(shields_list_contains,corne_oled_status)
```
