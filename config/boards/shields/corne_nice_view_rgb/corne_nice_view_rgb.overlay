/*
 * Corne Cherry v3 with nice!view and RGB uses the serial/TRRS data pin
 * for the LED chain. On nice!nano v2 / nRF52840 this is P0.08.
 */
&spi3_default {
    group1 {
        psels = <NRF_PSEL(SPIM_MOSI, 0, 8)>;
    };
};

&spi3_sleep {
    group1 {
        psels = <NRF_PSEL(SPIM_MOSI, 0, 8)>;
        low-power-enable;
    };
};
